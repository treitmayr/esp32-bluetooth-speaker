## components/syslog_client/Kconfig
```kconfig
menu "Syslog Client"

config SYSLOG_HOST
    string "Syslog Host Address"
    default ""
    help
        Host name or IP address to send log output to.

config SYSLOG_PORT
    int "Syslog Port Number"
    default 514
    help
        UDP port to send log output to.

config SYSLOG_SEND_RAW
    bool "Send raw data instead of syslog messages"
    default n
    help
        Select to send raw data instead of syslog messages.

config SYSLOG_COPY_SERIAL
    bool "Copy messages to serial console"
    default y
    help
        Select to print a copy of all messages to the serial console.

endmenu
```

## components/wifi_helper/Kconfig
```kconfig
menu "Wi-Fi Helper"

config WIFI_HELPER_CREDENTIALS_SYMBOL
    string "External symbol providing Wi-Fi credientials"
    default "wifi_credentials_txt"
    help
        External symbol corresponding to the embedded file holding Wi-Fi credentials.

        Example: File name "wifi_credentials.txt" -> symbol name "wifi_credentials_txt"

        The file format is "<SSID> <passphrase>", where one or more whitespaces are used to
        delimit the two words.

endmenu
```
